## CMakeLists.txt
```
#
# Copyright (c) 2021 Nordic Semiconductor ASA
#
# SPDX-License-Identifier: LicenseRef-Nordic-5-Clause
#

cmake_minimum_required(VERSION 3.20.0)

# Set Kconfig root files that will be processed as a first Kconfig for used child images.
set(mcuboot_KCONFIG_ROOT "\\\${ZEPHYR_CONNECTEDHOMEIP_MODULE_DIR}/config/nrfconnect/chip-module/Kconfig.mcuboot.root")
set(multiprotocol_rpmsg_KCONFIG_ROOT "\\\${ZEPHYR_CONNECTEDHOMEIP_MODULE_DIR}/config/nrfconnect/chip-module/Kconfig.multiprotocol_rpmsg.root")
set(hci_rpmsg_KCONFIG_ROOT "\\\${ZEPHYR_CONNECTEDHOMEIP_MODULE_DIR}/config/nrfconnect/chip-module/Kconfig.hci_rpmsg.root")

# For prj.conf the CONF_FILE is empty. In other case extract the exact file name from the path string.
if(CONF_FILE)
    get_filename_component(CONFIG_FILE_NAME ${CONF_FILE} NAME)
endif()

if("${CONFIG_FILE_NAME}" STREQUAL "prj_thread_wifi_switched.conf")
    set(PM_STATIC_YML_FILE ${CMAKE_CURRENT_SOURCE_DIR}/configuration/${BOARD}/pm_static_thread_wifi_switched.yml)
elseif(NOT "${CONFIG_FILE_NAME}" STREQUAL "prj_no_dfu.conf")
    set(PM_STATIC_YML_FILE ${CMAKE_CURRENT_SOURCE_DIR}/configuration/${BOARD}/pm_static_dfu.yml)
endif()

find_package(Zephyr HINTS $ENV{ZEPHYR_BASE})

project(matter-lock)

set(COMMON_ROOT ${ZEPHYR_NRF_MODULE_DIR}/samples/matter/common)
set(NLIO_ROOT ${ZEPHYR_CONNECTEDHOMEIP_MODULE_DIR}/third_party/nlio/repo)
include(${ZEPHYR_CONNECTEDHOMEIP_MODULE_DIR}/config/nrfconnect/app/enable-gnu-std.cmake)
include(${ZEPHYR_CONNECTEDHOMEIP_MODULE_DIR}/src/app/chip_data_model.cmake)

# NORDIC SDK APP START
target_include_directories(app PRIVATE
    src
    ${COMMON_ROOT}/src
    ${NLIO_ROOT}/include
    ${ZEPHYR_CONNECTEDHOMEIP_MODULE_DIR}/zzz_generated/app-common
)

target_sources(app PRIVATE
    src/app_task.cpp
    src/bolt_lock_manager.cpp
    src/main.cpp
    src/zcl_callbacks.cpp
    src/zap-generated/callback-stub.cpp
    src/zap-generated/IMClusterCommandHandler.cpp
    ${COMMON_ROOT}/src/led_widget.cpp
    ${COMMON_ROOT}/src/task_executor.cpp
    ${COMMON_ROOT}/src/board.cpp
    ${COMMON_ROOT}/src/matter_init.cpp
)

if(CONFIG_CHIP_OTA_REQUESTOR OR CONFIG_MCUMGR_TRANSPORT_BT)
    target_sources(app PRIVATE ${COMMON_ROOT}/src/ota_util.cpp)
endif()

if(CONFIG_CHIP_NUS)
    target_sources(app PRIVATE ${COMMON_ROOT}/src/bt_nus_service.cpp)
endif()

if(CONFIG_MCUMGR_TRANSPORT_BT)
    zephyr_library_link_libraries(MCUBOOT_BOOTUTIL)
    target_sources(app PRIVATE ${COMMON_ROOT}/src/dfu_over_smp.cpp)
endif()

if(CONFIG_THREAD_WIFI_SWITCHING)
    target_sources(app PRIVATE
        src/software_images_swapper.cpp
        ${COMMON_ROOT}/src/ota_multi_image_processor_impl.cpp
        ${COMMON_ROOT}/src/ota_multi_image_downloader.cpp
    )
endif()

chip_configure_data_model(app
    INCLUDE_SERVER
    BYPASS_IDL
    GEN_DIR src/zap-generated
    ZAP_FILE ${CMAKE_CURRENT_SOURCE_DIR}/src/lock.zap
)

if(CONFIG_THREAD_WIFI_SWITCHING)
    find_package(Python3)
    set(app_idx ${CONFIG_APPLICATION_IDX})
    add_custom_target(flash-external
        COMMAND ${Python3_EXECUTABLE} ${CMAKE_CURRENT_SOURCE_DIR}/src/flash-external.py
            --app ${APPLICATION_BINARY_DIR}/zephyr/app_update.bin
            --app-offset ${PM_APP_${app_idx}_CORE_APP_OFFSET}
            --app-size ${PM_APP_${app_idx}_CORE_APP_SIZE}
            --net ${APPLICATION_BINARY_DIR}/zephyr/net_core_app_update.bin
            --net-offset ${PM_APP_${app_idx}_CORE_NET_OFFSET}
            --net-size ${PM_APP_${app_idx}_CORE_NET_SIZE}
        USES_TERMINAL
        DEPENDS
            ${APPLICATION_BINARY_DIR}/zephyr/app_update.bin
            ${APPLICATION_BINARY_DIR}/zephyr/net_core_app_update.bin
    )
endif()
# NORDIC SDK APP END
```

## Kconfig
```
#
# Copyright (c) 2021 Nordic Semiconductor
#
# SPDX-License-Identifier: LicenseRef-Nordic-5-Clause
#

mainmenu "Matter Lock sample application"

config LOCK_NUM_USERS
	int "Maximum number of users supported by lock"
	default 10

config LOCK_NUM_CREDENTIALS
	int "Maximum number of credentials supported by lock"
	default 20

config LOCK_NUM_CREDENTIALS_PER_USER
	int "Maximum number of credentials per user supported by lock"
	default 3

config STATE_LEDS
	bool "Use LEDs to indicate the device state"
	default y
	help
	  Use LEDs to render the current state of the device such as the progress of commissioning of
	  the device into a network or the factory reset initiation. Note that setting this option to
	  'n' does not disable the LED indicating the state of the simulated bolt.

config THREAD_WIFI_SWITCHING
	bool "Switching between Thread and Wi-Fi network support"
	depends on SOC_SERIES_NRF53X
	depends on NET_L2_OPENTHREAD || CHIP_WIFI
	depends on CHIP_OTA_REQUESTOR
	select EXPERIMENTAL
	help
	  Enable the functionality that allows a user to switch between Matter over Thread and Matter
	  over Wi-Fi variants of the application, stored in the respective partitions in the external
	  flash memory.

if THREAD_WIFI_SWITCHING

config APPLICATION_IDX
	int
	default 1 if NET_L2_OPENTHREAD
	default 2 if CHIP_WIFI

config APPLICATION_OTHER_IDX
	int
	default 2 if NET_L2_OPENTHREAD
	default 1 if CHIP_WIFI

config APPLICATION_LABEL
	string
	default "Thread" if NET_L2_OPENTHREAD
	default "Wi-Fi" if CHIP_WIFI

config APPLICATION_OTHER_LABEL
	string
	default "Wi-Fi" if NET_L2_OPENTHREAD
	default "Thread" if CHIP_WIFI

config THREAD_WIFI_SWITCHING_CLI_SUPPORT
	bool "Add CLI command for triggering of the switch between Thread and Wi-Fi"
	default n
	select CHIP_LIB_SHELL

# We need more heap size for image swap buffers
config CHIP_MALLOC_SYS_HEAP_SIZE
	default 30720 if CHIP_WIFI
	default 10240 if NET_L2_OPENTHREAD

endif

# Sample configuration used for Thread networking
if NET_L2_OPENTHREAD

choice OPENTHREAD_NORDIC_LIBRARY_CONFIGURATION
	default OPENTHREAD_NORDIC_LIBRARY_MTD
endchoice

choice OPENTHREAD_DEVICE_TYPE
	default OPENTHREAD_MTD
endchoice

config CHIP_ENABLE_ICD_SUPPORT
	default y

# Reduce Thread TX output power to 0 dBm for SED device
config OPENTHREAD_DEFAULT_TX_POWER
	int
	default 0

endif # NET_L2_OPENTHREAD

if CHIP_WIFI

config NRF_WIFI_LOW_POWER
	default y

endif # CHIP_WIFI

source "${ZEPHYR_CONNECTEDHOMEIP_MODULE_DIR}/config/nrfconnect/chip-module/Kconfig.features"
source "${ZEPHYR_CONNECTEDHOMEIP_MODULE_DIR}/config/nrfconnect/chip-module/Kconfig.defaults"
source "${ZEPHYR_BASE}/../nrf/samples/matter/common/src/Kconfig"
source "Kconfig.zephyr"
```

## prj.conf
```kconfig
#
# Copyright (c) 2022 Nordic Semiconductor ASA
#
# SPDX-License-Identifier: LicenseRef-Nordic-5-Clause
#

# This sample uses Kconfig.defaults to set options common for all
# samples. This file should contain only options specific for this sample
# or overrides of default values.

# Enable CHIP
CONFIG_CHIP=y
CONFIG_CHIP_PROJECT_CONFIG="src/chip_project_config.h"
# 32774 == 0x8006 (example lock-app)
CONFIG_CHIP_DEVICE_PRODUCT_ID=32774
CONFIG_STD_CPP17=y

# Add support for LEDs and buttons on Nordic development kits
CONFIG_DK_LIBRARY=y

# Bluetooth Low Energy configuration
CONFIG_BT_DEVICE_NAME="MatterLock"

# Suspend devices when the CPU goes into sleep
CONFIG_PM_DEVICE=y

# Other settings
CONFIG_THREAD_NAME=y
CONFIG_MPU_STACK_GUARD=y
CONFIG_RESET_ON_FATAL_ERROR=n
CONFIG_CHIP_LIB_SHELL=y

# Reduce application size
CONFIG_USE_SEGGER_RTT=n

# Enable Factory Data feature
CONFIG_CHIP_FACTORY_DATA=y
CONFIG_CHIP_FACTORY_DATA_BUILD=y

# Enable heap debug features
CONFIG_CHIP_MALLOC_SYS_HEAP_DEBUG=y
CONFIG_SYS_HEAP_RUNTIME_STATS=y
```

## overlay-factory_data_build_1.conf
```kconfig
#
# Copyright (c) 2023 Nordic Semiconductor ASA
#
# SPDX-License-Identifier: LicenseRef-Nordic-5-Clause
#

# Use this overlay to re-generate new PAI and DAC certificates.
# Be sure that chip-cert executable is added to your system PATH.

# Enable building the new factory data
CONFIG_CHIP_FACTORY_DATA=y
CONFIG_CHIP_FACTORY_DATA_BUILD=y
CONFIG_CHIP_FACTORY_DATA_USE_DEFAULT_CERTS=n
CONFIG_CHIP_FACTORY_DATA_CERT_SOURCE_GENERATED=y
CONFIG_CHIP_FACTORY_DATA_MERGE_WITH_FIRMWARE=y
CONFIG_CHIP_DEVICE_GENERATE_ROTATING_DEVICE_UID=n

# Set up the Factory Data
CONFIG_CHIP_DEVICE_SERIAL_NUMBER="1"
CONFIG_CHIP_DEVICE_VENDOR_ID=65521
CONFIG_CHIP_DEVICE_VENDOR_NAME="Nordic Semiconductor ASA"
CONFIG_CHIP_DEVICE_PRODUCT_ID=32774
CONFIG_CHIP_DEVICE_PRODUCT_NAME="Door Lock"
CONFIG_CHIP_DEVICE_MANUFACTURING_DATE="2023-02-01"
CONFIG_CHIP_DEVICE_HARDWARE_VERSION=1
CONFIG_CHIP_DEVICE_HARDWARE_VERSION_STRING="SVE_Spring2023"
CONFIG_CHIP_DEVICE_DISCRIMINATOR=0xE46
CONFIG_CHIP_DEVICE_SPAKE2_PASSCODE=28073715
CONFIG_CHIP_DEVICE_SPAKE2_IT=1000
CONFIG_CHIP_DEVICE_SPAKE2_TEST_VERIFIER="XUQaKLznAVZ+WEWkSTIEJwvjaU/CuWY1qLbRKuS56VEE4Us+aJNGy3B3tLClZWRDAS5yXUgku5pHyFLgVTAKXQIo663Y2L7HvrJh/8jlD0OTNDDLlsnjKdj+l0b2rC3vMg=="
CONFIG_CHIP_DEVICE_ROTATING_DEVICE_UID="0989f27796617e00ff9dc844496dbcf3"
CONFIG_CHIP_DEVICE_ENABLE_KEY="d229322af1412d66ebeda07e0d39b80e"
```

## overlay-factory_data_build_2.conf
```kconfig
#
# Copyright (c) 2023 Nordic Semiconductor ASA
#
# SPDX-License-Identifier: LicenseRef-Nordic-5-Clause
#

# Use this overlay to re-generate new PAI and DAC certificates.
# Be sure that chip-cert executable is added to your system PATH.

# Enable building the new factory data
CONFIG_CHIP_FACTORY_DATA=y
CONFIG_CHIP_FACTORY_DATA_BUILD=y
CONFIG_CHIP_FACTORY_DATA_USE_DEFAULT_CERTS=n
CONFIG_CHIP_FACTORY_DATA_CERT_SOURCE_GENERATED=y
CONFIG_CHIP_FACTORY_DATA_MERGE_WITH_FIRMWARE=y
CONFIG_CHIP_DEVICE_GENERATE_ROTATING_DEVICE_UID=n

# Set up the Factory Data
CONFIG_CHIP_DEVICE_SERIAL_NUMBER="2"
CONFIG_CHIP_DEVICE_VENDOR_ID=65521
CONFIG_CHIP_DEVICE_VENDOR_NAME="Nordic Semiconductor ASA"
CONFIG_CHIP_DEVICE_PRODUCT_ID=32774
CONFIG_CHIP_DEVICE_PRODUCT_NAME="Door Lock"
CONFIG_CHIP_DEVICE_MANUFACTURING_DATE="2023-02-01"
CONFIG_CHIP_DEVICE_HARDWARE_VERSION=1
CONFIG_CHIP_DEVICE_HARDWARE_VERSION_STRING="SVE_Spring2023"
CONFIG_CHIP_DEVICE_DISCRIMINATOR=0x1fa
CONFIG_CHIP_DEVICE_SPAKE2_PASSCODE=80327003
CONFIG_CHIP_DEVICE_SPAKE2_IT=1000
CONFIG_CHIP_DEVICE_SPAKE2_TEST_VERIFIER="sMpmMvNf6t1TROKCjV9CnYwCMMV7l5YyXX/ajicjG1MEkZx8Ylg73OpW6w+BpfWeFgUBHreWf166zwxaTaY53y6cIFnu9HvWQofN0yKmnRjDZyZpBpb+2pR7bIdqUxcHcw=="
CONFIG_CHIP_DEVICE_ROTATING_DEVICE_UID="462a2785f8536233d6ce0427970fc596"
CONFIG_CHIP_DEVICE_ENABLE_KEY="5a9f1b3e358cc9934900aa6a2a085024"
```

## overlay-factory_data_build_3.conf
```kconfig
#
# Copyright (c) 2023 Nordic Semiconductor ASA
#
# SPDX-License-Identifier: LicenseRef-Nordic-5-Clause
#

# Use this overlay to re-generate new PAI and DAC certificates.
# Be sure that chip-cert executable is added to your system PATH.

# Enable building the new factory data
CONFIG_CHIP_FACTORY_DATA=y
CONFIG_CHIP_FACTORY_DATA_BUILD=y
CONFIG_CHIP_FACTORY_DATA_USE_DEFAULT_CERTS=n
CONFIG_CHIP_FACTORY_DATA_CERT_SOURCE_GENERATED=y
CONFIG_CHIP_FACTORY_DATA_MERGE_WITH_FIRMWARE=y
CONFIG_CHIP_DEVICE_GENERATE_ROTATING_DEVICE_UID=n

# Set up the Factory Data
CONFIG_CHIP_DEVICE_SERIAL_NUMBER="3"
CONFIG_CHIP_DEVICE_VENDOR_ID=65521
CONFIG_CHIP_DEVICE_VENDOR_NAME="Nordic Semiconductor ASA"
CONFIG_CHIP_DEVICE_PRODUCT_ID=32774
CONFIG_CHIP_DEVICE_PRODUCT_NAME="Door Lock"
CONFIG_CHIP_DEVICE_MANUFACTURING_DATE="2023-02-01"
CONFIG_CHIP_DEVICE_HARDWARE_VERSION=1
CONFIG_CHIP_DEVICE_HARDWARE_VERSION_STRING="SVE_Spring2023"
CONFIG_CHIP_DEVICE_DISCRIMINATOR=0x635
CONFIG_CHIP_DEVICE_SPAKE2_PASSCODE=65286841
CONFIG_CHIP_DEVICE_SPAKE2_IT=1000
CONFIG_CHIP_DEVICE_SPAKE2_TEST_VERIFIER="3kX890KClffU+BvLXQm68RDvXWlyuPofi8DEFkv74mQEnC+g02oLJTkItSDLBUvuYX87D1C7SnHZ7PuWvDziO57cHjPgUlkEhlRj+bvWKmE/FEwKuffl+VB7Dlx9HurJwQ=="
CONFIG_CHIP_DEVICE_ROTATING_DEVICE_UID="1566d6032a898e53f7d58133a19ac9d2"
CONFIG_CHIP_DEVICE_ENABLE_KEY="449eb9544ee3eef8d9fb7accb514fada"
```

## prj_no_dfu.conf
```kconfig
#
# Copyright (c) 2022 Nordic Semiconductor ASA
#
# SPDX-License-Identifier: LicenseRef-Nordic-5-Clause
#

# This sample uses Kconfig.defaults to set options common for all
# samples. This file should contain only options specific for this sample
# or overrides of default values.

# Enable CHIP
CONFIG_CHIP=y
CONFIG_CHIP_PROJECT_CONFIG="src/chip_project_config.h"
# 32774 == 0x8006 (example lock-app)
CONFIG_CHIP_DEVICE_PRODUCT_ID=32774
CONFIG_STD_CPP14=y

# Add support for LEDs and buttons on Nordic development kits
CONFIG_DK_LIBRARY=y

# Bluetooth Low Energy configuration
CONFIG_BT_DEVICE_NAME="MatterLock"

# Other settings
CONFIG_THREAD_NAME=y
CONFIG_MPU_STACK_GUARD=y
CONFIG_RESET_ON_FATAL_ERROR=n
CONFIG_CHIP_LIB_SHELL=y

# Disable Matter OTA DFU
CONFIG_CHIP_OTA_REQUESTOR=n

# Disable QSPI NOR
CONFIG_CHIP_QSPI_NOR=n

# Reduce application size
CONFIG_USE_SEGGER_RTT=n

CONFIG_CHIP_ROTATING_DEVICE_ID=y
CONFIG_CHIP_COMMISSIONABLE_DEVICE_TYPE=y
CONFIG_CHIP_DEVICE_TYPE=10
```

## prj_release.conf
```kconfig
#
# Copyright (c) 2022 Nordic Semiconductor ASA
#
# SPDX-License-Identifier: LicenseRef-Nordic-5-Clause
#

# This sample uses Kconfig.defaults to set options common for all
# samples. This file should contain only options specific for this sample
# or overrides of default values.

# Enable CHIP
CONFIG_CHIP=y
CONFIG_CHIP_PROJECT_CONFIG="src/chip_project_config.h"
# 32774 == 0x8006 (example lock-app)
CONFIG_CHIP_DEVICE_PRODUCT_ID=32774
CONFIG_STD_CPP17=y

# Add support for LEDs and buttons on Nordic development kits
CONFIG_DK_LIBRARY=y

# Bluetooth Low Energy configuration
CONFIG_BT_DEVICE_NAME="MatterLock"

# Suspend devices when the CPU goes into sleep
CONFIG_PM_DEVICE=y

# Disable all debug features
CONFIG_USE_SEGGER_RTT=n
CONFIG_SHELL=n
CONFIG_OPENTHREAD_SHELL=n
CONFIG_CONSOLE=n
CONFIG_UART_CONSOLE=n
CONFIG_SERIAL=n
CONFIG_LOG=n
CONFIG_LOG_MODE_MINIMAL=n
CONFIG_ASSERT_VERBOSE=n
CONFIG_ASSERT_NO_FILE_INFO=y
CONFIG_PRINTK=n
CONFIG_PRINTK_SYNC=n
CONFIG_THREAD_NAME=n
CONFIG_BOOT_BANNER=n

# Enable Factory Data feature
CONFIG_CHIP_FACTORY_DATA=y
CONFIG_CHIP_FACTORY_DATA_BUILD=y
```

## src/app_config.h
```c
/*
 * Copyright (c) 2022 Nordic Semiconductor ASA
 *
 * SPDX-License-Identifier: LicenseRef-Nordic-5-Clause
 */

#pragma once

/* ---- Lock Example App Config ---- */
```

## src/app_event.h
```c
/*
 * Copyright (c) 2021 Nordic Semiconductor ASA
 *
 * SPDX-License-Identifier: LicenseRef-Nordic-5-Clause
 */

#pragma once

#include <cstdint>

enum class AppEventType : uint8_t { None = 0, LockEvent, ThreadWiFiSwitch };
enum class SwitchButtonAction : uint8_t { Pressed = 0, Released };

struct AppEvent {
	AppEvent(AppEventType type) { mType = type; }
	AppEvent() = default;

	union {
		struct {
			void *Context;
		} LockEvent;
		struct {
			SwitchButtonAction ButtonAction;
		} ThreadWiFiSwitchEvent;
	};

	AppEventType mType{ AppEventType::None };
};
```

## src/app_task.cpp
```c
/*
 * Copyright (c) 2021 Nordic Semiconductor ASA
 *
 * SPDX-License-Identifier: LicenseRef-Nordic-5-Clause
 */

#include "app_task.h"
#include "app_event.h"
#include "task_executor.h"

#include "bolt_lock_manager.h"

#ifdef CONFIG_MCUMGR_TRANSPORT_BT
#include "dfu_over_smp.h"
#endif

#ifdef CONFIG_THREAD_WIFI_SWITCHING
#include "software_images_swapper.h"
#endif

#ifdef CONFIG_THREAD_WIFI_SWITCHING_CLI_SUPPORT
#include <lib/shell/Engine.h>
using chip::Shell::Engine;
using chip::Shell::shell_command_t;
#endif

#ifdef CONFIG_CHIP_NUS
#include "bt_nus_service.h"
#endif

#include "matter_init.h"

#include <app/server/OnboardingCodesUtil.h>

#include <app-common/zap-generated/attributes/Accessors.h>
#include <app/clusters/door-lock-server/door-lock-server.h>
#include <app/clusters/identify-server/identify-server.h>

#ifdef CONFIG_CHIP_WIFI
#include <app/clusters/network-commissioning/network-commissioning.h>
#include <platform/nrfconnect/wifi/NrfWiFiDriver.h>
#endif

#ifdef CONFIG_CHIP_OTA_REQUESTOR
#include "ota_util.h"
#endif

#include <zephyr/kernel.h>
#include <zephyr/logging/log.h>

#ifdef CONFIG_THREAD_WIFI_SWITCHING
#include <pm_config.h>
#endif

LOG_MODULE_DECLARE(app, CONFIG_CHIP_APP_LOG_LEVEL);

using namespace ::chip;
using namespace ::chip::app;
using namespace ::chip::DeviceLayer;

namespace
{
constexpr EndpointId kLockEndpointId = 1;

#ifdef CONFIG_CHIP_NUS
constexpr uint16_t kAdvertisingIntervalMin = 400;
constexpr uint16_t kAdvertisingIntervalMax = 500;
constexpr uint8_t kLockNUSPriority = 2;
#endif

#ifdef CONFIG_THREAD_WIFI_SWITCHING
k_timer sSwitchImagesTimer;
constexpr uint32_t kSwitchImagesTimeout = 10000;
#endif
} /* namespace */

Identify sIdentify = { kLockEndpointId, AppTask::IdentifyStartHandler, AppTask::IdentifyStopHandler,
		       Clusters::Identify::IdentifyTypeEnum::kVisibleIndicator };

CHIP_ERROR AppTask::Init()
{
	ReturnErrorOnFailure(nordic::matter::InitChipServer(ChipEventHandler));

	if (!GetBoard().Init(ButtonEventHandler)) {
		LOG_ERR("User interface initialization failed.");
		return CHIP_ERROR_INCORRECT_STATE;
	}

#ifdef CONFIG_THREAD_WIFI_SWITCHING
	k_timer_init(&sSwitchImagesTimer, &AppTask::SwitchImagesTimerTimeoutCallback, nullptr);
#endif

#ifdef CONFIG_CHIP_NUS
	/* Initialize Nordic UART Service for Lock purposes */
	if (!GetNUSService().Init(kLockNUSPriority, kAdvertisingIntervalMin, kAdvertisingIntervalMax)) {
		ChipLogError(Zcl, "Cannot initialize NUS service");
	}
	GetNUSService().RegisterCommand("Lock", sizeof("Lock"), NUSLockCallback, nullptr);
	GetNUSService().RegisterCommand("Unlock", sizeof("Unlock"), NUSUnlockCallback, nullptr);
	if (!GetNUSService().StartServer()) {
		LOG_ERR("GetNUSService().StartServer() failed");
	}
#endif

	/* Initialize lock manager */
	BoltLockMgr().Init(LockStateChanged);

#ifdef CONFIG_THREAD_WIFI_SWITCHING_CLI_SUPPORT
	RegisterSwitchCliCommand();
#endif

	ReturnErrorOnFailure(nordic::matter::StartChipServer());

	return nordic::matter::WaitForReadiness();
}

CHIP_ERROR AppTask::StartApp()
{
	ReturnErrorOnFailure(Init());

	while (true) {
		TaskExecutor::DispatchNextTask();
	}

	return CHIP_NO_ERROR;
}

void AppTask::IdentifyStartHandler(Identify *)
{
	TaskExecutor::PostTask([] { GetBoard().GetLED(DeviceLeds::kAppLED).Blink(LedConsts::kIdentifyBlinkRate_ms); });
}

void AppTask::IdentifyStopHandler(Identify *)
{
	TaskExecutor::PostTask([] { GetBoard().GetLED(DeviceLeds::kAppLED).Set(BoltLockMgr().IsLocked()); });
}

void AppTask::ButtonEventHandler(ButtonState state, ButtonMask hasChanged)
{
	if ((APPLICATION_BUTTON_MASK & hasChanged) & state) {
		TaskExecutor::PostTask([] { LockActionEventHandler(); });
	}

#ifdef CONFIG_THREAD_WIFI_SWITCHING
	if (USER_BUTTON_1_MASK & hasChanged) {
		AppEvent event(AppEventType::ThreadWiFiSwitch);
		event.ThreadWiFiSwitchEvent.ButtonAction =
			(FUNCTION_BUTTON_MASK & state) ? SwitchButtonAction::Pressed : SwitchButtonAction::Released;
		TaskExecutor::PostTask([event] { SwitchImagesTriggerHandler(event); });
	}
#endif

	if (FUNCTION_BUTTON_MASK & hasChanged & state) {
#ifdef CONFIG_MCUMGR_TRANSPORT_BT
		GetDFUOverSMP().StartServer();
#else
		LOG_INF("Software update is disabled");
#endif
	}
}

void AppTask::LockActionEventHandler()
{
	if (BoltLockMgr().IsLocked()) {
		BoltLockMgr().Unlock(BoltLockManager::OperationSource::kButton);
	} else {
		BoltLockMgr().Lock(BoltLockManager::OperationSource::kButton);
	}
}

#ifdef CONFIG_THREAD_WIFI_SWITCHING
void AppTask::SwitchImagesDone()
{
	/* Wipe out whole settings as they will not apply to the new application image. */
	chip::Server::GetInstance().ScheduleFactoryReset();
}

void AppTask::SwitchImagesEventHandler()
{
	LOG_INF("Switching application from " CONFIG_APPLICATION_LABEL " to " CONFIG_APPLICATION_OTHER_LABEL);

#define CONCAT3(a, b, c) UTIL_CAT(UTIL_CAT(a, b), c)
	SoftwareImagesSwapper::ImageLocation source = {
		.app_address = CONCAT3(PM_APP_, CONFIG_APPLICATION_OTHER_IDX, _CORE_APP_ADDRESS),
		.app_size = CONCAT3(PM_APP_, CONFIG_APPLICATION_OTHER_IDX, _CORE_APP_SIZE),
		.net_address = CONCAT3(PM_APP_, CONFIG_APPLICATION_OTHER_IDX, _CORE_NET_ADDRESS),
		.net_size = CONCAT3(PM_APP_, CONFIG_APPLICATION_OTHER_IDX, _CORE_NET_SIZE),
	};
#undef CONCAT3

	SoftwareImagesSwapper::Instance().Swap(source, AppTask::SwitchImagesDone);
}

void AppTask::SwitchImagesTimerTimeoutCallback(k_timer *timer)
{
	Instance().mSwitchImagesTimerActive = false;
	TaskExecutor::PostTask([] { SwitchImagesEventHandler(); });
}

void AppTask::SwitchImagesTriggerHandler(const AppEvent &event)
{
	if (event.ThreadWiFiSwitchEvent.ButtonAction == SwitchButtonAction::Pressed &&
	    !Instance().mSwitchImagesTimerActive) {
		k_timer_start(&sSwitchImagesTimer, K_MSEC(kSwitchImagesTimeout), K_NO_WAIT);
		Instance().mSwitchImagesTimerActive = true;
		LOG_INF("Keep button pressed for %u ms to switch application from " CONFIG_APPLICATION_LABEL
			" to " CONFIG_APPLICATION_OTHER_LABEL,
			kSwitchImagesTimeout);
	} else if (Instance().mSwitchImagesTimerActive) {
		k_timer_stop(&sSwitchImagesTimer);
		Instance().mSwitchImagesTimerActive = false;
		LOG_INF("Switching application from " CONFIG_APPLICATION_LABEL " to " CONFIG_APPLICATION_OTHER_LABEL
			" cancelled");
	}
}
#endif

void AppTask::ChipEventHandler(const ChipDeviceEvent *event, intptr_t /* arg */)
{
	bool isNetworkProvisioned = false;

	switch (event->Type) {
	case DeviceEventType::kCHIPoBLEAdvertisingChange:
#ifdef CONFIG_CHIP_NFC_COMMISSIONING
		if (event->CHIPoBLEAdvertisingChange.Result == kActivity_Started) {
			if (NFCMgr().IsTagEmulationStarted()) {
				LOG_INF("NFC Tag emulation is already started");
			} else {
				ShareQRCodeOverNFC(
					chip::RendezvousInformationFlags(chip::RendezvousInformationFlag::kBLE));
			}
		} else if (event->CHIPoBLEAdvertisingChange.Result == kActivity_Stopped) {
			NFCMgr().StopTagEmulation();
		}
#endif
		if (ConnectivityMgr().NumBLEConnections() != 0) {
			GetBoard().UpdateDeviceState(DeviceState::kDeviceConnectedBLE);
		}
		break;
#if defined(CONFIG_NET_L2_OPENTHREAD)
	case DeviceEventType::kDnssdInitialized:
#if CONFIG_CHIP_OTA_REQUESTOR
		InitBasicOTARequestor();
#endif /* CONFIG_CHIP_OTA_REQUESTOR */
		break;
	case DeviceEventType::kThreadStateChange:
		isNetworkProvisioned = ConnectivityMgr().IsThreadProvisioned() && ConnectivityMgr().IsThreadEnabled();
#elif defined(CONFIG_CHIP_WIFI)
	case DeviceEventType::kWiFiConnectivityChange:
		isNetworkProvisioned =
			ConnectivityMgr().IsWiFiStationProvisioned() && ConnectivityMgr().IsWiFiStationEnabled();
#if CONFIG_CHIP_OTA_REQUESTOR
		if (event->WiFiConnectivityChange.Result == kConnectivity_Established) {
			InitBasicOTARequestor();
		}
#endif /* CONFIG_CHIP_OTA_REQUESTOR */
#endif
		if (isNetworkProvisioned) {
			GetBoard().UpdateDeviceState(DeviceState::kDeviceProvisioned);
		} else {
			GetBoard().UpdateDeviceState(DeviceState::kDeviceDisconnected);
		}
		break;
	default:
		break;
	}
}

void AppTask::LockStateChanged(BoltLockManager::State state, BoltLockManager::OperationSource source)
{
	switch (state) {
	case BoltLockManager::State::kLockingInitiated:
		LOG_INF("Lock action initiated");
		GetBoard().GetLED(DeviceLeds::kAppLED).Blink(50, 50);
#ifdef CONFIG_CHIP_NUS
		GetNUSService().SendData("locking", sizeof("locking"));
#endif
		break;
	case BoltLockManager::State::kLockingCompleted:
		LOG_INF("Lock action completed");
		GetBoard().GetLED(DeviceLeds::kAppLED).Set(true);
#ifdef CONFIG_CHIP_NUS
		GetNUSService().SendData("locked", sizeof("locked"));
#endif
		break;
	case BoltLockManager::State::kUnlockingInitiated:
		LOG_INF("Unlock action initiated");
		GetBoard().GetLED(DeviceLeds::kAppLED).Blink(50, 50);
#ifdef CONFIG_CHIP_NUS
		GetNUSService().SendData("unlocking", sizeof("unlocking"));
#endif
		break;
	case BoltLockManager::State::kUnlockingCompleted:
		LOG_INF("Unlock action completed");
#ifdef CONFIG_CHIP_NUS
		GetNUSService().SendData("unlocked", sizeof("unlocked"));
#endif
		GetBoard().GetLED(DeviceLeds::kAppLED).Set(false);
		break;
	}

	/* Handle changing attribute state in the application */
	Instance().UpdateClusterState(state, source);
}

void AppTask::UpdateClusterState(BoltLockManager::State state, BoltLockManager::OperationSource source)
{
	DlLockState newLockState;

	switch (state) {
	case BoltLockManager::State::kLockingCompleted:
		newLockState = DlLockState::kLocked;
		break;
	case BoltLockManager::State::kUnlockingCompleted:
		newLockState = DlLockState::kUnlocked;
		break;
	default:
		newLockState = DlLockState::kNotFullyLocked;
		break;
	}

	SystemLayer().ScheduleLambda([newLockState, source] {
		chip::app::DataModel::Nullable<chip::app::Clusters::DoorLock::DlLockState> currentLockState;
		chip::app::Clusters::DoorLock::Attributes::LockState::Get(kLockEndpointId, currentLockState);

		if (currentLockState.IsNull()) {
			/* Initialize lock state with start value, but not invoke lock/unlock. */
			chip::app::Clusters::DoorLock::Attributes::LockState::Set(kLockEndpointId, newLockState);
		} else {
			LOG_INF("Updating LockState attribute");

			if (!DoorLockServer::Instance().SetLockState(kLockEndpointId, newLockState, source)) {
				LOG_ERR("Failed to update LockState attribute");
			}
		}
	});
}

#ifdef CONFIG_THREAD_WIFI_SWITCHING_CLI_SUPPORT
void AppTask::RegisterSwitchCliCommand()
{
	static const shell_command_t sSwitchCommand = { [](int, char **) {
							       AppTask::Instance().SwitchImagesEventHandler();
							       return CHIP_NO_ERROR;
						       },
							"switch_images",
							"Switch between Thread and Wi-Fi application variants" };
	Engine::Root().RegisterCommands(&sSwitchCommand, 1);
}
#endif

#ifdef CONFIG_CHIP_NUS
void AppTask::NUSLockCallback(void *context)
{
	LOG_DBG("Received LOCK command from NUS");
	if (BoltLockMgr().mState == BoltLockManager::State::kLockingCompleted ||
	    BoltLockMgr().mState == BoltLockManager::State::kLockingInitiated) {
		LOG_INF("Device is already locked");
	} else {
		TaskExecutor::PostTask([] { LockActionEventHandler(); });
	}
}

void AppTask::NUSUnlockCallback(void *context)
{
	LOG_DBG("Received UNLOCK command from NUS");
	if (BoltLockMgr().mState == BoltLockManager::State::kUnlockingCompleted ||
	    BoltLockMgr().mState == BoltLockManager::State::kUnlockingInitiated) {
		LOG_INF("Device is already unlocked");
	} else {
		TaskExecutor::PostTask([] { LockActionEventHandler(); });
	}
}
#endif
```

## src/app_task.h
```c
/*
 * Copyright (c) 2021 Nordic Semiconductor ASA
 *
 * SPDX-License-Identifier: LicenseRef-Nordic-5-Clause
 */

#pragma once

#include "board.h"
#include "bolt_lock_manager.h"
#include "led_widget.h"

#include <platform/CHIPDeviceLayer.h>

#if CONFIG_CHIP_FACTORY_DATA
#include <platform/nrfconnect/FactoryDataProvider.h>
#else
#include <platform/nrfconnect/DeviceInstanceInfoProviderImpl.h>
#endif

#ifdef CONFIG_MCUMGR_TRANSPORT_BT
#include "dfu_over_smp.h"
#endif

struct k_timer;
struct Identify;

class AppTask {
public:
	static AppTask &Instance()
	{
		static AppTask sAppTask;
		return sAppTask;
	};

	CHIP_ERROR StartApp();

	void UpdateClusterState(BoltLockManager::State state, BoltLockManager::OperationSource source);
	static void IdentifyStartHandler(Identify *);
	static void IdentifyStopHandler(Identify *);

private:
	CHIP_ERROR Init();

	static void LockActionEventHandler();
	static void ButtonEventHandler(ButtonState state, ButtonMask hasChanged);
	static void ChipEventHandler(const chip::DeviceLayer::ChipDeviceEvent *event, intptr_t arg);
	static void LockStateChanged(BoltLockManager::State state, BoltLockManager::OperationSource source);

#ifdef CONFIG_THREAD_WIFI_SWITCHING
	static void SwitchImagesDone();
	static void SwitchImagesTriggerHandler(const AppEvent &event);
	static void SwitchImagesTimerTimeoutCallback(k_timer *timer);
	static void SwitchImagesEventHandler();

	bool mSwitchImagesTimerActive = false;
#endif

#ifdef CONFIG_CHIP_NUS
	static void NUSLockCallback(void *context);
	static void NUSUnlockCallback(void *context);
#endif

#ifdef CONFIG_THREAD_WIFI_SWITCHING_CLI_SUPPORT
	static void RegisterSwitchCliCommand();
#endif

	bool mFunctionTimerActive = false;
};
```

## src/bolt_lock_manager.cpp
```c
/*
 * Copyright (c) 2021 Nordic Semiconductor ASA
 *
 * SPDX-License-Identifier: LicenseRef-Nordic-5-Clause
 */

#include "bolt_lock_manager.h"
#include "task_executor.h"

#include "app_task.h"

using namespace chip;

BoltLockManager BoltLockManager::sLock;

void BoltLockManager::Init(StateChangeCallback callback)
{
	mStateChangeCallback = callback;

	k_timer_init(&mActuatorTimer, &BoltLockManager::ActuatorTimerEventHandler, nullptr);
	k_timer_user_data_set(&mActuatorTimer, this);

	/* Set the default state */
	GetBoard().GetLED(DeviceLeds::kAppLED).Set(IsLocked());
}

bool BoltLockManager::GetUser(uint16_t userIndex, EmberAfPluginDoorLockUserInfo &user) const
{
	/* userIndex is guaranteed by the caller to be between 1 and CONFIG_LOCK_NUM_USERS */
	user = mUsers[userIndex - 1];

	ChipLogProgress(Zcl, "Getting lock user %u: %s", static_cast<unsigned>(userIndex),
			user.userStatus == UserStatusEnum::kAvailable ? "available" : "occupied");

	return true;
}

bool BoltLockManager::SetUser(uint16_t userIndex, FabricIndex creator, FabricIndex modifier, const CharSpan &userName,
			      uint32_t uniqueId, UserStatusEnum userStatus, UserTypeEnum userType,
			      CredentialRuleEnum credentialRule, const CredentialStruct *credentials,
			      size_t totalCredentials)
{
	/* userIndex is guaranteed by the caller to be between 1 and CONFIG_LOCK_NUM_USERS */
	UserData &userData = mUserData[userIndex - 1];
	auto &user = mUsers[userIndex - 1];

	VerifyOrReturnError(userName.size() <= DOOR_LOCK_MAX_USER_NAME_SIZE, false);
	VerifyOrReturnError(totalCredentials <= CONFIG_LOCK_NUM_CREDENTIALS_PER_USER, false);

	Platform::CopyString(userData.mName, userName);
	memcpy(userData.mCredentials, credentials, totalCredentials * sizeof(CredentialStruct));

	user.userName = CharSpan(userData.mName, userName.size());
	user.credentials = Span<const CredentialStruct>(userData.mCredentials, totalCredentials);
	user.userUniqueId = uniqueId;
	user.userStatus = userStatus;
	user.userType = userType;
	user.credentialRule = credentialRule;
	user.creationSource = DlAssetSource::kMatterIM;
	user.createdBy = creator;
	user.modificationSource = DlAssetSource::kMatterIM;
	user.lastModifiedBy = modifier;

	ChipLogProgress(Zcl, "Setting lock user %u: %s", static_cast<unsigned>(userIndex),
			userStatus == UserStatusEnum::kAvailable ? "available" : "occupied");

	return true;
}

bool BoltLockManager::GetCredential(uint16_t credentialIndex, CredentialTypeEnum credentialType,
				    EmberAfPluginDoorLockCredentialInfo &credential) const
{
	VerifyOrReturnError(credentialIndex > 0 && credentialIndex <= CONFIG_LOCK_NUM_CREDENTIALS, false);

	credential = mCredentials[credentialIndex - 1];

	ChipLogProgress(Zcl, "Getting lock credential %u: %s", static_cast<unsigned>(credentialIndex),
			credential.status == DlCredentialStatus::kAvailable ? "available" : "occupied");

	return true;
}

bool BoltLockManager::SetCredential(uint16_t credentialIndex, FabricIndex creator, FabricIndex modifier,
				    DlCredentialStatus credentialStatus, CredentialTypeEnum credentialType,
				    const ByteSpan &secret)
{
	VerifyOrReturnError(credentialIndex > 0 && credentialIndex <= CONFIG_LOCK_NUM_CREDENTIALS, false);
	VerifyOrReturnError(secret.size() <= kMaxCredentialLength, false);

	CredentialData &credentialData = mCredentialData[credentialIndex - 1];
	auto &credential = mCredentials[credentialIndex - 1];

	if (!secret.empty()) {
		memcpy(credentialData.mSecret.Alloc(secret.size()).Get(), secret.data(), secret.size());
	}

	credential.status = credentialStatus;
	credential.credentialType = credentialType;
	credential.credentialData = ByteSpan(credentialData.mSecret.Get(), secret.size());
	credential.creationSource = DlAssetSource::kMatterIM;
	credential.createdBy = creator;
	credential.modificationSource = DlAssetSource::kMatterIM;
	credential.lastModifiedBy = modifier;

	ChipLogProgress(Zcl, "Setting lock credential %u: %s", static_cast<unsigned>(credentialIndex),
			credential.status == DlCredentialStatus::kAvailable ? "available" : "occupied");

	return true;
}

bool BoltLockManager::ValidatePIN(const Optional<ByteSpan> &pinCode, OperationErrorEnum &err) const
{
	/* Optionality of the PIN code is validated by the caller, so assume it is OK not to provide the PIN code. */
	if (!pinCode.HasValue()) {
		return true;
	}

	/* Check the PIN code */
	for (const auto &credential : mCredentials) {
		if (credential.status == DlCredentialStatus::kAvailable ||
		    credential.credentialType != CredentialTypeEnum::kPin) {
			continue;
		}

		if (credential.credentialData.data_equal(pinCode.Value())) {
			ChipLogDetail(Zcl, "Valid lock PIN code provided");
			return true;
		}
	}

	ChipLogDetail(Zcl, "Invalid lock PIN code provided");
	err = OperationErrorEnum::kInvalidCredential;

	return false;
}

void BoltLockManager::Lock(OperationSource source)
{
	VerifyOrReturn(mState != State::kLockingCompleted);
	SetState(State::kLockingInitiated, source);

	mActuatorOperationSource = source;
	k_timer_start(&mActuatorTimer, K_MSEC(kActuatorMovementTimeMs), K_NO_WAIT);
}

void BoltLockManager::Unlock(OperationSource source)
{
	VerifyOrReturn(mState != State::kUnlockingCompleted);
	SetState(State::kUnlockingInitiated, source);

	mActuatorOperationSource = source;
	k_timer_start(&mActuatorTimer, K_MSEC(kActuatorMovementTimeMs), K_NO_WAIT);
}

void BoltLockManager::ActuatorTimerEventHandler(k_timer *timer)
{
	/*
	 * The timer event handler is called in the context of the system clock ISR.
	 * Post an event to the application task queue to process the event in the
	 * context of the application thread.
	 */

	AppEvent event(AppEventType::LockEvent);
	event.LockEvent.Context = static_cast<BoltLockManager *>(k_timer_user_data_get(timer));
	TaskExecutor::PostTask([event] { ActuatorAppEventHandler(event); });
}

void BoltLockManager::ActuatorAppEventHandler(const AppEvent &event)
{
	BoltLockManager *lock = reinterpret_cast<BoltLockManager *>(event.LockEvent.Context);

	switch (lock->mState) {
	case State::kLockingInitiated:
		lock->SetState(State::kLockingCompleted, lock->mActuatorOperationSource);
		break;
	case State::kUnlockingInitiated:
		lock->SetState(State::kUnlockingCompleted, lock->mActuatorOperationSource);
		break;
	default:
		break;
	}
}

void BoltLockManager::SetState(State state, OperationSource source)
{
	mState = state;

	if (mStateChangeCallback != nullptr) {
		mStateChangeCallback(state, source);
	}
}
```

## src/bolt_lock_manager.h
```c
/*
 * Copyright (c) 2021 Nordic Semiconductor ASA
 *
 * SPDX-License-Identifier: LicenseRef-Nordic-5-Clause
 */

#pragma once

#include <app/clusters/door-lock-server/door-lock-server.h>
#include <lib/core/ClusterEnums.h>

#include "app_event.h"

#include <zephyr/kernel.h>

#include <cstdint>

class AppEvent;

class BoltLockManager {
public:
	static constexpr size_t kMaxCredentialLength = 128;

	enum class State : uint8_t {
		kLockingInitiated = 0,
		kLockingCompleted,
		kUnlockingInitiated,
		kUnlockingCompleted,
	};

	struct UserData {
		char mName[DOOR_LOCK_USER_NAME_BUFFER_SIZE];
		CredentialStruct mCredentials[CONFIG_LOCK_NUM_CREDENTIALS_PER_USER];
	};

	struct CredentialData {
		chip::Platform::ScopedMemoryBuffer<uint8_t> mSecret;
	};

	using OperationSource = chip::app::Clusters::DoorLock::OperationSourceEnum;
	using StateChangeCallback = void (*)(State, OperationSource);

	static constexpr uint32_t kActuatorMovementTimeMs = 2000;

	void Init(StateChangeCallback callback);

	State GetState() const { return mState; }
	bool IsLocked() const { return mState == State::kLockingCompleted; }

	bool GetUser(uint16_t userIndex, EmberAfPluginDoorLockUserInfo &user) const;
	bool SetUser(uint16_t userIndex, chip::FabricIndex creator, chip::FabricIndex modifier,
		     const chip::CharSpan &userName, uint32_t uniqueId, UserStatusEnum userStatus,
		     UserTypeEnum userType, CredentialRuleEnum credentialRule, const CredentialStruct *credentials,
		     size_t totalCredentials);

	bool GetCredential(uint16_t credentialIndex, CredentialTypeEnum credentialType,
			   EmberAfPluginDoorLockCredentialInfo &credential) const;
	bool SetCredential(uint16_t credentialIndex, chip::FabricIndex creator, chip::FabricIndex modifier,
			   DlCredentialStatus credentialStatus, CredentialTypeEnum credentialType,
			   const chip::ByteSpan &secret);

	bool ValidatePIN(const Optional<chip::ByteSpan> &pinCode, OperationErrorEnum &err) const;

	void Lock(OperationSource source);
	void Unlock(OperationSource source);

private:
	friend class AppTask;

	void SetState(State state, OperationSource source);

	static void ActuatorTimerEventHandler(k_timer *timer);
	static void ActuatorAppEventHandler(const AppEvent &event);
	friend BoltLockManager &BoltLockMgr();

	State mState = State::kLockingCompleted;
	StateChangeCallback mStateChangeCallback = nullptr;
	OperationSource mActuatorOperationSource = OperationSource::kButton;
	k_timer mActuatorTimer = {};

	UserData mUserData[CONFIG_LOCK_NUM_USERS];
	EmberAfPluginDoorLockUserInfo mUsers[CONFIG_LOCK_NUM_USERS] = {};

	CredentialData mCredentialData[CONFIG_LOCK_NUM_CREDENTIALS];
	EmberAfPluginDoorLockCredentialInfo mCredentials[CONFIG_LOCK_NUM_CREDENTIALS] = {};

	static BoltLockManager sLock;
};

inline BoltLockManager &BoltLockMgr()
{
	return BoltLockManager::sLock;
}
```

## src/zcl_callbacks.cpp
```c
/*
 * Copyright (c) 2021 Nordic Semiconductor ASA
 *
 * SPDX-License-Identifier: LicenseRef-Nordic-5-Clause
 */

#include "app_task.h"
#include "bolt_lock_manager.h"

#include <app-common/zap-generated/attributes/Accessors.h>
#include <app-common/zap-generated/ids/Clusters.h>
#include <app/ConcreteAttributePath.h>
#include <app/clusters/door-lock-server/door-lock-server.h>
#include <lib/support/CodeUtils.h>

using namespace ::chip;
using namespace ::chip::app::Clusters;
using namespace ::chip::app::Clusters::DoorLock;

void MatterPostAttributeChangeCallback(const chip::app::ConcreteAttributePath &attributePath, uint8_t type,
				       uint16_t size, uint8_t *value)
{
	VerifyOrReturn(attributePath.mClusterId == DoorLock::Id &&
		       attributePath.mAttributeId == DoorLock::Attributes::LockState::Id);

	/* Post events only if current lock state is different than given */
	switch (*value) {
	case to_underlying(DlLockState::kLocked):
		BoltLockMgr().Lock(BoltLockManager::OperationSource::kRemote);
		break;
	case to_underlying(DlLockState::kUnlocked):
		BoltLockMgr().Unlock(BoltLockManager::OperationSource::kRemote);
		break;
	default:
		break;
	}
}

bool emberAfPluginDoorLockGetUser(EndpointId endpointId, uint16_t userIndex, EmberAfPluginDoorLockUserInfo &user)
{
	return BoltLockMgr().GetUser(userIndex, user);
}

bool emberAfPluginDoorLockSetUser(EndpointId endpointId, uint16_t userIndex, FabricIndex creator, FabricIndex modifier,
				  const CharSpan &userName, uint32_t uniqueId, UserStatusEnum userStatus,
				  UserTypeEnum userType, CredentialRuleEnum credentialRule,
				  const CredentialStruct *credentials, size_t totalCredentials)
{
	return BoltLockMgr().SetUser(userIndex, creator, modifier, userName, uniqueId, userStatus, userType,
				     credentialRule, credentials, totalCredentials);
}

bool emberAfPluginDoorLockGetCredential(EndpointId endpointId, uint16_t credentialIndex,
					CredentialTypeEnum credentialType,
					EmberAfPluginDoorLockCredentialInfo &credential)
{
	return BoltLockMgr().GetCredential(credentialIndex, credentialType, credential);
}

bool emberAfPluginDoorLockSetCredential(EndpointId endpointId, uint16_t credentialIndex, FabricIndex creator,
					FabricIndex modifier, DlCredentialStatus credentialStatus,
					CredentialTypeEnum credentialType, const ByteSpan &secret)
{
	return BoltLockMgr().SetCredential(credentialIndex, creator, modifier, credentialStatus, credentialType,
					   secret);
}

bool emberAfPluginDoorLockOnDoorLockCommand(EndpointId endpointId, const Optional<ByteSpan> &pinCode,
					    OperationErrorEnum &err)
{
	bool result = BoltLockMgr().ValidatePIN(pinCode, err);

	/* Handle changing attribute state on command reception */
	if (result) {
		BoltLockMgr().Lock(BoltLockManager::OperationSource::kRemote);
	}

	return result;
}

bool emberAfPluginDoorLockOnDoorUnlockCommand(EndpointId endpointId, const Optional<ByteSpan> &pinCode,
					      OperationErrorEnum &err)
{
	bool result = BoltLockMgr().ValidatePIN(pinCode, err);

	/* Handle changing attribute state on command reception */
	if (result) {
		BoltLockMgr().Unlock(BoltLockManager::OperationSource::kRemote);
	}

	return result;
}

void emberAfDoorLockClusterInitCallback(EndpointId endpoint)
{
	DoorLockServer::Instance().InitServer(endpoint);

	const auto logOnFailure = [](EmberAfStatus status, const char *attributeName) {
		if (status != EMBER_ZCL_STATUS_SUCCESS) {
			ChipLogError(Zcl, "Failed to set DoorLock %s: %x", attributeName, status);
		}
	};

	logOnFailure(DoorLock::Attributes::LockType::Set(endpoint, DlLockType::kDeadBolt), "type");
	logOnFailure(DoorLock::Attributes::NumberOfTotalUsersSupported::Set(endpoint, CONFIG_LOCK_MAX_NUM_USERS),
		     "number of users");
	logOnFailure(DoorLock::Attributes::NumberOfPINUsersSupported::Set(endpoint, CONFIG_LOCK_NUM_CREDENTIALS_TYPE),
		     "number of PIN users");
	logOnFailure(DoorLock::Attributes::NumberOfRFIDUsersSupported::Set(endpoint, CONFIG_LOCK_NUM_CREDENTIALS_TYPE),
		     "number of RFID users");
	logOnFailure(DoorLock::Attributes::NumberOfCredentialsSupportedPerUser::Set(
			     endpoint, CONFIG_LOCK_TOTAL_NUM_CREDENTIALS_PER_USER),
		     "number of credentials per user");

	/* Set FeatureMap to (kUser|kCredentialsOverTheAirAccess|kFingerCredentials|kRfidCredential|kPinCredential|) */
	logOnFailure(DoorLock::Attributes::FeatureMap::Set(endpoint, 0x187), "feature map");

	AppTask::Instance().UpdateClusterState(BoltLockMgr().GetState(),
					       BoltLockManager::OperationSource::kUnspecified);
}

bool emberAfPluginDoorLockGetNumberOfFingerprintCredentialsSupported(chip::EndpointId endpointId,
								     uint16_t &maxNumberOfCredentials)
{
	maxNumberOfCredentials = CONFIG_LOCK_NUM_CREDENTIALS_TYPE;
	return true;
}

bool emberAfPluginDoorLockGetNumberOfFingerVeinCredentialsSupported(chip::EndpointId endpointId,
								    uint16_t &maxNumberOfCredentials)
{
	maxNumberOfCredentials = CONFIG_LOCK_NUM_CREDENTIALS_TYPE;
	return true;
}

bool emberAfPluginDoorLockGetFingerprintCredentialLengthConstraints(chip::EndpointId endpointId, uint8_t &minLen,
								    uint8_t &maxLen)
{
	static constexpr uint8_t sDefaultMinLen{ 10 };
	static constexpr uint8_t sDefaultMaxLen{ 30 };
	minLen = sDefaultMinLen;
	maxLen = sDefaultMaxLen;
	return true;
}

bool emberAfPluginDoorLockGetFingerVeinCredentialLengthConstraints(chip::EndpointId endpointId, uint8_t &minLen,
								   uint8_t &maxLen)
{
	static constexpr uint8_t sDefaultMinLen{ 10 };
	static constexpr uint8_t sDefaultMaxLen{ 30 };
	minLen = sDefaultMinLen;
	maxLen = sDefaultMaxLen;
	return true;
}
```

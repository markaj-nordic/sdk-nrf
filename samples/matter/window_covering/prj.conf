## prj.conf
```kconfig
#
# Copyright (c) 2022 Nordic Semiconductor ASA
#
# SPDX-License-Identifier: LicenseRef-Nordic-5-Clause
#

# This sample uses Kconfig.defaults to set options common for all
# samples. This file should contain only options specific for this sample
# or overrides of default values.

# Enable CHIP
CONFIG_CHIP=y
CONFIG_CHIP_PROJECT_CONFIG="src/chip_project_config.h"
# 32784 == 0x8010 (example window-app)
CONFIG_CHIP_DEVICE_PRODUCT_ID=32784
CONFIG_STD_CPP17=y

# Add support for LEDs and buttons on Nordic development kits
CONFIG_DK_LIBRARY=y

# PWM support
CONFIG_PWM=y

# OpenThread configs
CONFIG_OPENTHREAD_NORDIC_LIBRARY_MTD=y
CONFIG_OPENTHREAD_MTD=y
CONFIG_OPENTHREAD_FTD=n
CONFIG_CHIP_ENABLE_ICD_SUPPORT=y
CONFIG_CHIP_THREAD_SSED=y
CONFIG_CHIP_ICD_SLOW_POLL_INTERVAL=500
CONFIG_CHIP_ICD_FAST_POLLING_INTERVAL=500

# Bluetooth Low Energy configuration
CONFIG_BT_DEVICE_NAME="MatterWinCov"

# Suspend devices when the CPU goes into sleep
CONFIG_PM_DEVICE=y

# Stack size settings
CONFIG_IEEE802154_NRF5_RX_STACK_SIZE=1024

# Other settings
CONFIG_THREAD_NAME=y
CONFIG_MPU_STACK_GUARD=y
CONFIG_RESET_ON_FATAL_ERROR=n
CONFIG_CHIP_LIB_SHELL=y

# Reduce application size
CONFIG_USE_SEGGER_RTT=n

# Enable Factory Data feature
CONFIG_CHIP_FACTORY_DATA=y
CONFIG_CHIP_FACTORY_DATA_BUILD=y

# Enable heap debug features
CONFIG_CHIP_MALLOC_SYS_HEAP_DEBUG=y
CONFIG_SYS_HEAP_RUNTIME_STATS=y
```

## prj_release.conf
```kconfig
#
# Copyright (c) 2022 Nordic Semiconductor ASA
#
# SPDX-License-Identifier: LicenseRef-Nordic-5-Clause
#

# This sample uses Kconfig.defaults to set options common for all
# samples. This file should contain only options specific for this sample
# or overrides of default values.

# Enable CHIP
CONFIG_CHIP=y
CONFIG_CHIP_PROJECT_CONFIG="src/chip_project_config.h"
# 32784 == 0x8010 (example window-app)
CONFIG_CHIP_DEVICE_PRODUCT_ID=32784
CONFIG_STD_CPP17=y

# Add support for LEDs and buttons on Nordic development kits
CONFIG_DK_LIBRARY=y

# PWM support
CONFIG_PWM=y

# OpenThread configs
CONFIG_OPENTHREAD_NORDIC_LIBRARY_MTD=y
CONFIG_OPENTHREAD_MTD=y
CONFIG_OPENTHREAD_FTD=n
CONFIG_CHIP_ENABLE_ICD_SUPPORT=y
CONFIG_CHIP_THREAD_SSED=y
CONFIG_CHIP_ICD_SLOW_POLL_INTERVAL=500
CONFIG_CHIP_ICD_FAST_POLLING_INTERVAL=500

# Bluetooth Low Energy configuration
CONFIG_BT_DEVICE_NAME="MatterWinCov"

# Suspend devices when the CPU goes into sleep
CONFIG_PM_DEVICE=y

# Stack size settings
CONFIG_IEEE802154_NRF5_RX_STACK_SIZE=1024

# Disable all debug features
CONFIG_USE_SEGGER_RTT=n
CONFIG_SHELL=n
CONFIG_OPENTHREAD_SHELL=n
CONFIG_CONSOLE=n
CONFIG_UART_CONSOLE=n
CONFIG_SERIAL=n
CONFIG_LOG=n
CONFIG_LOG_MODE_MINIMAL=n
CONFIG_ASSERT_VERBOSE=n
CONFIG_ASSERT_NO_FILE_INFO=y
CONFIG_PRINTK=n
CONFIG_PRINTK_SYNC=n
CONFIG_THREAD_NAME=n
CONFIG_BOOT_BANNER=n

# Enable Factory Data feature
CONFIG_CHIP_FACTORY_DATA=y
CONFIG_CHIP_FACTORY_DATA_BUILD=y
```

## src/app_config.h
```c
/*
 * Copyright (c) 2022 Nordic Semiconductor ASA
 *
 * SPDX-License-Identifier: LicenseRef-Nordic-5-Clause
 */

#pragma once

#define OPEN_BUTTON DK_BTN2
#define OPEN_BUTTON_MASK DK_BTN2_MSK
#define CLOSE_BUTTON DK_BTN3
#define CLOSE_BUTTON_MASK DK_BTN3_MSK
```

## src/app_event.h
```c
/*
 * Copyright (c) 2022 Nordic Semiconductor ASA
 *
 * SPDX-License-Identifier: LicenseRef-Nordic-5-Clause
 */

#pragma once

#include <cstdint>

enum class AppEventType : uint8_t { None = 0, WindowButton };

enum class WindowButtonAction : uint8_t { Pushed, Released };

enum class WindowButton : uint8_t { OpenButton, CloseButton };

struct AppEvent {
	AppEvent(AppEventType type) { mType = type; }
	AppEvent() = default;

	union {
		struct {
			WindowButton Button;
			WindowButtonAction Action;
		} WindowButtonEvent;
	};

	AppEventType mType{ AppEventType::None };
};
```

## src/app_task.cpp
```c
/*
 * Copyright (c) 2022 Nordic Semiconductor ASA
 *
 * SPDX-License-Identifier: LicenseRef-Nordic-5-Clause
 */

#include "app_task.h"

#include "fabric_table_delegate.h"
#include "task_executor.h"
#include "window_covering.h"

#include <app/clusters/identify-server/identify-server.h>
#include <app/server/OnboardingCodesUtil.h>
#include <app/server/Server.h>
#include <app/util/attribute-storage.h>
#include <credentials/DeviceAttestationCredsProvider.h>
#include <credentials/examples/DeviceAttestationCredsExample.h>

#ifdef CONFIG_CHIP_OTA_REQUESTOR
#include "ota_util.h"
#endif

#include <dk_buttons_and_leds.h>
#include <zephyr/kernel.h>
#include <zephyr/logging/log.h>

LOG_MODULE_DECLARE(app, CONFIG_CHIP_APP_LOG_LEVEL);

using namespace ::chip;
using namespace ::chip::app;
using namespace ::chip::Credentials;
using namespace ::chip::DeviceLayer;

namespace
{
Identify sIdentify = { WindowCovering::Endpoint(), AppTask::IdentifyStartHandler, AppTask::IdentifyStopHandler,
		       Clusters::Identify::IdentifyTypeEnum::kVisibleIndicator };

} /* namespace */

CHIP_ERROR AppTask::Init()
{
	/* Initialize CHIP stack */
	LOG_INF("Init CHIP stack");

	CHIP_ERROR err = chip::Platform::MemoryInit();
	if (err != CHIP_NO_ERROR) {
		LOG_ERR("Platform::MemoryInit() failed");
		return err;
	}

	err = PlatformMgr().InitChipStack();
	if (err != CHIP_NO_ERROR) {
		LOG_ERR("PlatformMgr().InitChipStack() failed");
		return err;
	}

	err = ThreadStackMgr().InitThreadStack();
	if (err != CHIP_NO_ERROR) {
		LOG_ERR("ThreadStackMgr().InitThreadStack() failed: %s", ErrorStr(err));
		return err;
	}

#if CONFIG_CHIP_THREAD_SSED
	err = ConnectivityMgr().SetThreadDeviceType(ConnectivityManager::kThreadDeviceType_SynchronizedSleepyEndDevice);
#elif CONFIG_OPENTHREAD_MTD_SED
	err = ConnectivityMgr().SetThreadDeviceType(ConnectivityManager::kThreadDeviceType_SleepyEndDevice);
#else
	err = ConnectivityMgr().SetThreadDeviceType(ConnectivityManager::kThreadDeviceType_MinimalEndDevice);
#endif
	if (err != CHIP_NO_ERROR) {
		LOG_ERR("ConnectivityMgr().SetThreadDeviceType() failed: %s", ErrorStr(err));
		return err;
	}

	if (!GetBoard().Init(ButtonEventHandler)) {
		LOG_ERR("User interface initialization failed.");
		return CHIP_ERROR_INCORRECT_STATE;
	}

#ifdef CONFIG_CHIP_OTA_REQUESTOR
	/* OTA image confirmation must be done before the factory data init. */
	OtaConfirmNewImage();
#endif

#ifdef CONFIG_MCUMGR_TRANSPORT_BT
	/* Initialize DFU over SMP */
	GetDFUOverSMP().Init();
	GetDFUOverSMP().ConfirmNewImage();
#endif

	/* Initialize CHIP server */
#if CONFIG_CHIP_FACTORY_DATA
	ReturnErrorOnFailure(mFactoryDataProvider.Init());
	SetDeviceInstanceInfoProvider(&mFactoryDataProvider);
	SetDeviceAttestationCredentialsProvider(&mFactoryDataProvider);
	SetCommissionableDataProvider(&mFactoryDataProvider);
#else
	SetDeviceInstanceInfoProvider(&DeviceInstanceInfoProviderMgrImpl());
	SetDeviceAttestationCredentialsProvider(Examples::GetExampleDACProvider());
#endif

	static CommonCaseDeviceServerInitParams initParams;
	(void)initParams.InitializeStaticResourcesBeforeServerInit();

	ReturnErrorOnFailure(chip::Server::GetInstance().Init(initParams));
	ConfigurationMgr().LogDeviceConfig();
	PrintOnboardingCodes(chip::RendezvousInformationFlags(chip::RendezvousInformationFlag::kBLE));
	AppFabricTableDelegate::Init();

	/*
	 * Add CHIP event handler and start CHIP thread.
	 * Note that all the initialization code should happen prior to this point to avoid data races
	 * between the main and the CHIP threads.
	 */
	PlatformMgr().AddEventHandler(ChipEventHandler, 0);

	err = PlatformMgr().StartEventLoopTask();
	if (err != CHIP_NO_ERROR) {
		LOG_ERR("PlatformMgr().StartEventLoopTask() failed");
		return err;
	}

	WindowCovering::Instance().PositionLEDUpdate(WindowCovering::MoveType::LIFT);
	WindowCovering::Instance().PositionLEDUpdate(WindowCovering::MoveType::TILT);

	return CHIP_NO_ERROR;
}

CHIP_ERROR AppTask::StartApp()
{
	ReturnErrorOnFailure(Init());

	while (true) {
		TaskExecutor::DispatchNextTask();
	}

	return CHIP_NO_ERROR;
}

void AppTask::IdentifyStartHandler(Identify *)
{
	TaskExecutor::PostTask([] {
		WindowCovering::Instance().GetLiftIndicator().SuppressOutput();
		GetBoard().GetLED(DeviceLeds::kAppLED).Blink(LedConsts::kIdentifyBlinkRate_ms);
	});
}

void AppTask::IdentifyStopHandler(Identify *)
{
	TaskExecutor::PostTask([] {
		GetBoard().GetLED(DeviceLeds::kAppLED).Set(false);
		WindowCovering::Instance().GetLiftIndicator().ApplyLevel();
	});
}

void AppTask::ButtonEventHandler(ButtonState state, ButtonMask hasChanged)
{
	AppEvent event(AppEventType::WindowButton);

	if (OPEN_BUTTON_MASK & hasChanged) {
		event.WindowButtonEvent.Button = WindowButton::OpenButton;
		event.WindowButtonEvent.Action =
			(OPEN_BUTTON_MASK & state) ? WindowButtonAction::Pushed : WindowButtonAction::Released;
		TaskExecutor::PostTask([event] { OpenHandler(event); });
	}

	if (CLOSE_BUTTON_MASK & hasChanged) {
		event.WindowButtonEvent.Button = WindowButton::CloseButton;
		event.WindowButtonEvent.Action =
			(CLOSE_BUTTON_MASK & state) ? WindowButtonAction::Pushed : WindowButtonAction::Released;
		TaskExecutor::PostTask([event] { CloseHandler(event); });
	}

	if (FUNCTION_BUTTON_MASK & hasChanged & state) {
#ifdef CONFIG_MCUMGR_TRANSPORT_BT
		GetDFUOverSMP().StartServer();
#else
		LOG_INF("Software update is disabled");
#endif
	}
}

void AppTask::OpenHandler(const AppEvent &event)
{
	if (event.WindowButtonEvent.Button != WindowButton::OpenButton) {
		return;
	}

	if (event.WindowButtonEvent.Action == WindowButtonAction::Pushed) {
		Instance().mOpenButtonIsPressed = true;
		if (Instance().mCloseButtonIsPressed) {
			Instance().ToggleMoveType();
		}
	} else if (event.WindowButtonEvent.Action == WindowButtonAction::Released) {
		if (!Instance().mCloseButtonIsPressed) {
			if (!Instance().mMoveTypeRecentlyChanged) {
				WindowCovering::Instance().SetSingleStepTarget(OperationalState::MovingUpOrOpen);
			} else {
				Instance().mMoveTypeRecentlyChanged = false;
			}
		}
		Instance().mOpenButtonIsPressed = false;
	}
}

void AppTask::CloseHandler(const AppEvent &event)
{
	if (event.WindowButtonEvent.Button != WindowButton::CloseButton) {
		return;
	}

	if (event.WindowButtonEvent.Action == WindowButtonAction::Pushed) {
		Instance().mCloseButtonIsPressed = true;
		if (Instance().mOpenButtonIsPressed) {
			Instance().ToggleMoveType();
		}
	} else if (event.WindowButtonEvent.Action == WindowButtonAction::Released) {
		if (!Instance().mOpenButtonIsPressed) {
			if (!Instance().mMoveTypeRecentlyChanged) {
				WindowCovering::Instance().SetSingleStepTarget(OperationalState::MovingDownOrClose);
			} else {
				Instance().mMoveTypeRecentlyChanged = false;
			}
		}
		Instance().mCloseButtonIsPressed = false;
	}
}

void AppTask::ToggleMoveType()
{
	if (WindowCovering::Instance().GetMoveType() == WindowCovering::MoveType::LIFT) {
		WindowCovering::Instance().SetMoveType(WindowCovering::MoveType::TILT);
		LOG_INF("Window covering move: tilt");
	} else {
		WindowCovering::Instance().SetMoveType(WindowCovering::MoveType::LIFT);
		LOG_INF("Window covering move: lift");
	}
	mMoveTypeRecentlyChanged = true;
}

void AppTask::ChipEventHandler(const ChipDeviceEvent *event, intptr_t /* arg */)
{
	bool isNetworkProvisioned = false;

	switch (event->Type) {
	case DeviceEventType::kCHIPoBLEAdvertisingChange:
#ifdef CONFIG_CHIP_NFC_COMMISSIONING
		if (event->CHIPoBLEAdvertisingChange.Result == kActivity_Started) {
			if (NFCMgr().IsTagEmulationStarted()) {
				LOG_INF("NFC Tag emulation is already started");
			} else {
				ShareQRCodeOverNFC(
					chip::RendezvousInformationFlags(chip::RendezvousInformationFlag::kBLE));
			}
		} else if (event->CHIPoBLEAdvertisingChange.Result == kActivity_Stopped) {
			NFCMgr().StopTagEmulation();
		}
#endif
		if (ConnectivityMgr().NumBLEConnections() != 0) {
			GetBoard().UpdateDeviceState(DeviceState::kDeviceConnectedBLE);
		}
		break;
	case DeviceEventType::kThreadStateChange:
		isNetworkProvisioned = ConnectivityMgr().IsThreadProvisioned() && ConnectivityMgr().IsThreadEnabled();
		if (isNetworkProvisioned) {
			GetBoard().UpdateDeviceState(DeviceState::kDeviceProvisioned);
		} else {
			GetBoard().UpdateDeviceState(DeviceState::kDeviceDisconnected);
		}
		break;
	case DeviceEventType::kDnssdInitialized:
#if CONFIG_CHIP_OTA_REQUESTOR
		InitBasicOTARequestor();
#endif
		break;
	default:
		break;
	}
}
```

## src/app_task.h
```c
/*
 * Copyright (c) 2022 Nordic Semiconductor ASA
 *
 * SPDX-License-Identifier: LicenseRef-Nordic-5-Clause
 */

#pragma once

#include "app_event.h"
#include "led_widget.h"
#include "window_covering.h"

#include <platform/CHIPDeviceLayer.h>

#if CONFIG_CHIP_FACTORY_DATA
#include <platform/nrfconnect/FactoryDataProvider.h>
#else
#include <platform/nrfconnect/DeviceInstanceInfoProviderImpl.h>
#endif

#ifdef CONFIG_MCUMGR_TRANSPORT_BT
#include "dfu_over_smp.h"
#endif

struct Identify;

class AppTask {
public:
	static AppTask &Instance()
	{
		static AppTask sAppTask;
		return sAppTask;
	};

	CHIP_ERROR StartApp();

	static void IdentifyStartHandler(Identify *);
	static void IdentifyStopHandler(Identify *);

private:
	CHIP_ERROR Init();
	void ToggleMoveType();

	static void MovementTimerEventHandler(const AppEvent &event);
	static void OpenHandler(const AppEvent &event);
	static void CloseHandler(const AppEvent &event);

	static void ChipEventHandler(const chip::DeviceLayer::ChipDeviceEvent *event, intptr_t arg);
	static void ButtonEventHandler(ButtonState state, ButtonMask hasChanged);

	OperationalState mMoveType{ OperationalState::MovingUpOrOpen };
	bool mMovementTimerActive{ false };
	bool mOpenButtonIsPressed{ false };
	bool mCloseButtonIsPressed{ false };
	bool mMoveTypeRecentlyChanged{ false };

#if CONFIG_CHIP_FACTORY_DATA
	chip::DeviceLayer::FactoryDataProvider<chip::DeviceLayer::InternalFlashFactoryData> mFactoryDataProvider;
#endif
};
```

## src/window_covering.cpp
```c
/*
 * Copyright (c) 2022 Nordic Semiconductor ASA
 *
 * SPDX-License-Identifier: LicenseRef-Nordic-5-Clause
 */

#include "window_covering.h"
#include "app_config.h"
#include "pwm_device.h"

#include <dk_buttons_and_leds.h>

#include <app-common/zap-generated/attributes/Accessors.h>
#include <app/util/af.h>
#include <platform/CHIPDeviceLayer.h>
#include <zephyr/kernel.h>
#include <zephyr/logging/log.h>

LOG_MODULE_DECLARE(app, CONFIG_CHIP_APP_LOG_LEVEL);

using namespace ::chip::Credentials;
using namespace ::chip::DeviceLayer;
using namespace chip::app::Clusters::WindowCovering;

static const struct pwm_dt_spec sLiftPwmDevice = PWM_DT_SPEC_GET(DT_ALIAS(pwm_led1));
static const struct pwm_dt_spec sTiltPwmDevice = PWM_DT_SPEC_GET(DT_ALIAS(pwm_led2));

static constexpr uint32_t sMoveTimeoutMs{ 200 };

WindowCovering::WindowCovering()
{
	if (mLiftIndicator.Init(&sLiftPwmDevice, 0, 255) != 0) {
		LOG_ERR("Cannot initialize the lift indicator");
	}
	if (mTiltIndicator.Init(&sTiltPwmDevice, 0, 255) != 0) {
		LOG_ERR("Cannot initialize the tilt indicator");
	}
}

void WindowCovering::DriveCurrentLiftPosition(intptr_t)
{
	NPercent100ths current{};
	NPercent100ths target{};
	NPercent100ths positionToSet{};

	VerifyOrReturn(Attributes::CurrentPositionLiftPercent100ths::Get(Endpoint(), current) ==
		       EMBER_ZCL_STATUS_SUCCESS);
	VerifyOrReturn(Attributes::TargetPositionLiftPercent100ths::Get(Endpoint(), target) ==
		       EMBER_ZCL_STATUS_SUCCESS);

	OperationalState state = ComputeOperationalState(target, current);
	UpdateOperationalStatus(MoveType::LIFT, state);

	chip::Percent100ths position = CalculateNextPosition(MoveType::LIFT);

	if (state == OperationalState::MovingUpOrOpen) {
		positionToSet.SetNonNull(position > target.Value() ? position : target.Value());
	} else if (state == OperationalState::MovingDownOrClose) {
		positionToSet.SetNonNull(position < target.Value() ? position : target.Value());
	} else {
		positionToSet.SetNonNull(current.Value());
	}

	LiftPositionSet(Endpoint(), positionToSet);

	/* assume single move completed */
	Instance().mInLiftMove = false;

	VerifyOrReturn(Attributes::CurrentPositionLiftPercent100ths::Get(Endpoint(), current) ==
		       EMBER_ZCL_STATUS_SUCCESS);

	if (!TargetCompleted(MoveType::LIFT, current, target)) {
		/* continue to move */
		StartTimer(MoveType::LIFT, sMoveTimeoutMs);
	} else {
		/* the OperationalStatus should indicate no-lift-movement after the target is completed */
		UpdateOperationalStatus(MoveType::LIFT, ComputeOperationalState(target, current));
	}
}

chip::Percent100ths WindowCovering::CalculateNextPosition(MoveType aMoveType)
{
	EmberAfStatus status{};
	chip::Percent100ths percent100ths{};
	NPercent100ths current{};
	OperationalState opState{};

	if (aMoveType == MoveType::LIFT) {
		status = Attributes::CurrentPositionLiftPercent100ths::Get(Endpoint(), current);
		opState = OperationalStateGet(Endpoint(), OperationalStatus::kLift);
	} else if (aMoveType == MoveType::TILT) {
		status = Attributes::CurrentPositionTiltPercent100ths::Get(Endpoint(), current);
		opState = OperationalStateGet(Endpoint(), OperationalStatus::kTilt);
	}

	if ((status == EMBER_ZCL_STATUS_SUCCESS) && !current.IsNull()) {
		static constexpr auto sPercentDelta{ WC_PERCENT100THS_MAX_CLOSED / 20 };
		percent100ths = ComputePercent100thsStep(opState, current.Value(), sPercentDelta);
	} else {
		LOG_ERR("Cannot read the current lift position. Error: %d", static_cast<uint8_t>(status));
	}

	return percent100ths;
}

bool WindowCovering::TargetCompleted(MoveType aMoveType, NPercent100ths aCurrent, NPercent100ths aTarget)
{
	return (OperationalState::Stall == ComputeOperationalState(aTarget, aCurrent));
}

void WindowCovering::StartTimer(MoveType aMoveType, uint32_t aTimeoutMs)
{
	MoveType *moveType = chip::Platform::New<MoveType>();
	VerifyOrReturn(moveType != nullptr);

	*moveType = aMoveType;
	(void)chip::DeviceLayer::SystemLayer().StartTimer(chip::System::Clock::Milliseconds32(aTimeoutMs),
							  MoveTimerTimeoutCallback, reinterpret_cast<void *>(moveType));
}

void WindowCovering::MoveTimerTimeoutCallback(chip::System::Layer *systemLayer, void *appState)
{
	MoveType *moveType = reinterpret_cast<MoveType *>(appState);
	VerifyOrReturn(moveType != nullptr);

	if (*moveType == MoveType::LIFT) {
		chip::DeviceLayer::PlatformMgr().ScheduleWork(WindowCovering::DriveCurrentLiftPosition);
	} else if (*moveType == MoveType::TILT) {
		chip::DeviceLayer::PlatformMgr().ScheduleWork(WindowCovering::DriveCurrentTiltPosition);
	}

	chip::Platform::Delete(moveType);
}

void WindowCovering::DriveCurrentTiltPosition(intptr_t)
{
	NPercent100ths current{};
	NPercent100ths target{};
	NPercent100ths positionToSet{};

	VerifyOrReturn(Attributes::CurrentPositionTiltPercent100ths::Get(Endpoint(), current) ==
		       EMBER_ZCL_STATUS_SUCCESS);
	VerifyOrReturn(Attributes::TargetPositionTiltPercent100ths::Get(Endpoint(), target) ==
		       EMBER_ZCL_STATUS_SUCCESS);

	OperationalState state = ComputeOperationalState(target, current);
	UpdateOperationalStatus(MoveType::TILT, state);

	chip::Percent100ths position = CalculateNextPosition(MoveType::TILT);

	if (state == OperationalState::MovingUpOrOpen) {
		positionToSet.SetNonNull(position > target.Value() ? position : target.Value());
	} else if (state == OperationalState::MovingDownOrClose) {
		positionToSet.SetNonNull(position < target.Value() ? position : target.Value());
	} else {
		positionToSet.SetNonNull(current.Value());
	}

	TiltPositionSet(Endpoint(), positionToSet);

	/* assume single move completed */
	Instance().mInTiltMove = false;

	VerifyOrReturn(Attributes::CurrentPositionTiltPercent100ths::Get(Endpoint(), current) ==
		       EMBER_ZCL_STATUS_SUCCESS);

	if (!TargetCompleted(MoveType::TILT, current, target)) {
		/* continue to move */
		StartTimer(MoveType::TILT, sMoveTimeoutMs);
	} else {
		/* the OperationalStatus should indicate no-tilt-movement after the target is completed */
		UpdateOperationalStatus(MoveType::TILT, ComputeOperationalState(target, current));
	}
}

void WindowCovering::StartMove(MoveType aMoveType)
{
	switch (aMoveType) {
	case MoveType::LIFT:
		if (!mInLiftMove) {
			mInLiftMove = true;
			StartTimer(aMoveType, sMoveTimeoutMs);
		}
		break;
	case MoveType::TILT:
		if (!mInTiltMove) {
			mInTiltMove = true;
			StartTimer(aMoveType, sMoveTimeoutMs);
		}
		break;
	default:
		break;
	};
}

void WindowCovering::SetSingleStepTarget(OperationalState aDirection)
{
	UpdateOperationalStatus(mCurrentUIMoveType, aDirection);
	SetTargetPosition(aDirection, CalculateNextPosition(mCurrentUIMoveType));
}

void WindowCovering::UpdateOperationalStatus(MoveType aMoveType, OperationalState aDirection)
{
	switch (aMoveType) {
	case MoveType::LIFT:
		OperationalStateSet(Endpoint(), OperationalStatus::kLift, aDirection);
		break;
	case MoveType::TILT:
		OperationalStateSet(Endpoint(), OperationalStatus::kTilt, aDirection);
		break;
	case MoveType::NONE:
		break;
	default:
		break;
	}
}

void WindowCovering::SetTargetPosition(OperationalState aDirection, chip::Percent100ths aPosition)
{
	EmberAfStatus status{};
	if (Instance().mCurrentUIMoveType == MoveType::LIFT) {
		status = Attributes::TargetPositionLiftPercent100ths::Set(Endpoint(), aPosition);
	} else if (Instance().mCurrentUIMoveType == MoveType::TILT) {
		status = Attributes::TargetPositionTiltPercent100ths::Set(Endpoint(), aPosition);
	}

	if (status != EMBER_ZCL_STATUS_SUCCESS) {
		LOG_ERR("Cannot set the target position. Error: %d", static_cast<uint8_t>(status));
	}
}

void WindowCovering::PositionLEDUpdate(MoveType aMoveType)
{
	EmberAfStatus status{};
	NPercent100ths currentPosition{};

	if (aMoveType == MoveType::LIFT) {
		status = Attributes::CurrentPositionLiftPercent100ths::Get(Endpoint(), currentPosition);
		if (EMBER_ZCL_STATUS_SUCCESS == status && !currentPosition.IsNull()) {
			Instance().SetBrightness(MoveType::LIFT, currentPosition.Value());
		}
	} else if (aMoveType == MoveType::TILT) {
		status = Attributes::CurrentPositionTiltPercent100ths::Get(Endpoint(), currentPosition);
		if (EMBER_ZCL_STATUS_SUCCESS == status && !currentPosition.IsNull()) {
			Instance().SetBrightness(MoveType::TILT, currentPosition.Value());
		}
	}
}

void WindowCovering::SetBrightness(MoveType aMoveType, uint16_t aPosition)
{
	uint8_t brightness = PositionToBrightness(aPosition, aMoveType);
	if (aMoveType == MoveType::LIFT) {
		mLiftIndicator.InitiateAction(PWMDevice::LEVEL_ACTION, 0, &brightness);
	} else if (aMoveType == MoveType::TILT) {
		mTiltIndicator.InitiateAction(PWMDevice::LEVEL_ACTION, 0, &brightness);
	}
}

uint8_t WindowCovering::PositionToBrightness(uint16_t aPosition, MoveType aMoveType)
{
	AbsoluteLimits pwmLimits{};

	if (aMoveType == MoveType::LIFT) {
		pwmLimits.open = mLiftIndicator.GetMinLevel();
		pwmLimits.closed = mLiftIndicator.GetMaxLevel();
	} else if (aMoveType == MoveType::TILT) {
		pwmLimits.open = mTiltIndicator.GetMinLevel();
		pwmLimits.closed = mTiltIndicator.GetMaxLevel();
	}

	return Percent100thsToValue(pwmLimits, aPosition);
}

void WindowCovering::SchedulePostAttributeChange(chip::EndpointId aEndpoint, chip::AttributeId aAttributeId)
{
	AttributeUpdateData *data = chip::Platform::New<AttributeUpdateData>();
	VerifyOrReturn(data != nullptr);

	data->mEndpoint = aEndpoint;
	data->mAttributeId = aAttributeId;

	chip::DeviceLayer::PlatformMgr().ScheduleWork(DoPostAttributeChange, reinterpret_cast<intptr_t>(data));
}

void WindowCovering::DoPostAttributeChange(intptr_t aArg)
{
	AttributeUpdateData *data = reinterpret_cast<AttributeUpdateData *>(aArg);
	VerifyOrReturn(data != nullptr);

	PostAttributeChange(data->mEndpoint, data->mAttributeId);
}
```
